#include <Wire.h>
#include <string.h>
#include <stdio.h>

#include "ssd1306.h"

#include <SPI.h>

#include "SdFat.h"

typedef unsigned char byte;

const unsigned char o[] PROGMEM = {
  0xFF,
  0xFF,
  0xFF,
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  0xFF,
};

static SdFat32 sd;
static File32  bp;

static int tick = 0;

static byte buf[6048] = {};

void setup() {
  Serial.begin(9600);

  while(!Serial);

  pinMode(53, OUTPUT);

  memset(buf, 0, 6048);

  if (!sd.begin(SdSpiConfig(53, DEDICATED_SPI, SD_SCK_MHZ(50)))) {
    Serial.println("SD Card Init... Failed");
    while (1);
  }

  ssd1306_128x64_i2c_init();

  ssd1306_clearScreen();
  ssd1306_fillScreen(0);

  bp.open("eup.bin");
}

void loop() {
  if (Serial.available()) {
    Serial.read();

    if (tick >= 3777) {
      bp.close();
      sd.end();
      return;
    }
    
    if(tick % 9 == 0){
      bp.read(buf, 6048);
    }

    ssd1306_drawBufferFast(16, 1, 96, 56, buf + ((tick % 9) * 672));

    tick++;
  }
}
